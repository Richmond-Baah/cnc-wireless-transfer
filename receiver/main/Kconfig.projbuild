## receiver/main/Kconfig.projbuild
```kconfig
menu "CNC Wireless Transfer"

config CNC_DEFAULT_WIFI_SSID
    string "Default Wi-Fi SSID"
    default "CNC_WIRELESS"
    help
        Default SSID the receiver will connect to (should match the
        transmitter's AP SSID). Can be overridden via NVS at runtime.

config CNC_DEFAULT_WIFI_PASSWORD
    string "Default Wi-Fi Password"
    default "cnc12345"
    help
        Default password for the Wi-Fi network the receiver connects to.
        Must be at least 8 characters. Can be overridden via NVS at runtime.

config CNC_MDNS_HOSTNAME
    string "mDNS Hostname"
    default "cnc"
    help
        mDNS hostname prefix; the receiver ID is appended
        (e.g. cnc-rx-a1b2c3.local) so several receivers can coexist.

config CNC_MDNS_SERVICE
    string "mDNS Service Type"
    default "_cnc-wireless"
    help
        Service type advertised via mDNS. The transmitter will browse
        for this service to discover the receiver.

config CNC_USB_READ_LOG
    bool "Log USB host read activity"
    default y
    help
        While the USB host is reading, log once per second to the UART
        console: number of READ10 commands, bytes read and min/max LBA.

config CNC_WIFI_MAX_TX_POWER
    int "Wi-Fi max TX power (units of 0.25 dBm)"
    range 8 84
    default 34
    help
        Applied with esp_wifi_set_max_tx_power() after esp_wifi_start().
        34 = 8.5 dBm (default). 78 = 19.5 dBm, 84 = 21 dBm (max).
        High power can brown out small ESP32-S3 boards (weak LDO/antenna)
        and leave the AP invisible; raise only if the supply is solid.

endmenu
```

## transmitter/main/Kconfig.projbuild
```kconfig
menu "CNC Wireless Transfer"

config CNC_DEFAULT_WIFI_SSID
    string "Default Wi-Fi SSID"
    default "CNC_WIRELESS"
    help
        Default SSID for the Wi-Fi access point (transmitter) or
        station connection (receiver). Can be overridden via NVS at runtime.

config CNC_DEFAULT_WIFI_PASSWORD
    string "Default Wi-Fi Password"
    default "cnc12345"
    help
        Default password for the Wi-Fi network.
        Must be at least 8 characters. Leave empty for open networks.
        Can be overridden via NVS at runtime.

config CNC_DEFAULT_WEB_USER
    string "Default Web UI Username"
    default "admin"
    help
        Default username for the web interface login.
        Can be changed via the web UI Settings panel after first login.

config CNC_DEFAULT_WEB_PASS
    string "Default Web UI Password"
    default "admin123"
    help
        Default password for the web interface login.
        IMPORTANT: Change this before deploying to production!
        Can be changed via the web UI Settings panel after first login.


config CNC_WIFI_MAX_TX_POWER
    int "Wi-Fi max TX power (units of 0.25 dBm)"
    range 8 84
    default 34
    help
        Applied with esp_wifi_set_max_tx_power() after esp_wifi_start().
        34 = 8.5 dBm (default). 78 = 19.5 dBm, 84 = 21 dBm (max).
        High power can brown out small ESP32-S3 boards (weak LDO/antenna)
        and leave the AP invisible; raise only if the supply is solid.

config CNC_HTTP_REQ_LOG
    bool "Log every web request (path, duration, open sockets)"
    default y
    help
        One INFO line per HTTP request with its duration and the number of
        open client sockets, plus a warning for any handler over 500 ms.
        Turn off once the web UI is known to be healthy.

endmenu
```
